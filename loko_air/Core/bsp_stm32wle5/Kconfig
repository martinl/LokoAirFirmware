## loko_air/Core/bsp_stm32wle5/Kconfig
```kconfig
mainmenu "STM32WL BSP Configuration"

config BSP_USE_ADC
    bool "Add to build RTC interface"
    default n

config BSP_USE_RTC
    bool "Add to build RTC interface"
    default n

config BSP_USE_UART
    bool "Add to build RTC interface"
    default n

config BSP_USE_FLASH
    bool "Add to build RTC interface"
    default n

config BSP_USE_RADIO
    bool "Add to build RTC interface"
    default n
```

## loko_air/Kconfig
```kconfig
mainmenu "LoKo project configuration"

choice
    prompt "BSP name"
    default LOKO_AIR

    config LOKO_AIR
        bool "LOKO_AIR"
    config LOKO_AIR_SEEED_E5
         bool "LOKO_AIR_SEEED_E5"
    config LOKO_CPPUTEST
         bool "LOKO_CPPUTEST"
endchoice


config BOOTLOADER_BUILD
    bool "is bootloader project"
    default n


rsource "Core/bsp_stm32wle5/Kconfig"
```
